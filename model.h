#pragma once

#include <Arduino.h>
#include <LittleFS.h>

/* ---------------------------------------------------------------------------
 * 内置 int8 量化模型（原始 const 数组，放 flash .rodata，不占 RAM）
 *   ★ 这段数组内容不要动，只改它的名字和外面包的指针。
 * ------------------------------------------------------------------------- */
static const unsigned char g_model_builtin[] = {
  0x20, 0x00, 0x00, 0x00, 0x54, 0x46, 0x4c, 0x33, 0x00, 0x00, 0x00, 0x00, 
  0x14, 0x00, 0x20, 0x00, 0x1c, 0x00, 0x18, 0x00, 0x14, 0x00, 0x10, 0x00, 
  0x0c, 0x00, 0x00, 0x00, 0x08, 0x00, 0x04, 0x00, 0x14, 0x00, 0x00, 0x00, 
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  0x03, 0x00, 0x00, 0x00, 0x03, 0x00, 0x00, 0x00, 0x00, 0x00, 0x00, 0x03, 
};

static const unsigned int g_model_builtin_len = 21432;

/* ---------------------------------------------------------------------------
 * 当前生效的模型：默认指向内置数组
 *   thermal_sensor.h 里 tflite::GetModel(g_model) 读的就是这个指针。
 *   一旦 modelLoad() 从 LittleFS 加载成功，就指向堆上的动态缓冲。
 * ------------------------------------------------------------------------- */
const unsigned char *g_model     = g_model_builtin;
unsigned int         g_model_len = g_model_builtin_len;

/* 动态缓冲（只在从文件加载成功时分配；全程不释放也行） */
static unsigned char *g_model_dyn     = nullptr;
static unsigned int   g_model_dyn_len = 0;

/* ---------------------------------------------------------------------------
 * 尝试从 LittleFS 加载 /amg_model_int8.tflite
 *   成功 → g_model 指向堆缓冲，返回 true
 *   失败 → 保持原来的模型（旧动态缓冲或内置数组），返回 false
 *
 *   reload = false（默认）：已经加载过动态模型就直接复用，不重复读 flash。
 *   reload = true         ：强制重新读文件（下载了新模型之后用）。
 *
 *   ★ 释放旧缓冲放在「新缓冲校验通过之后」—— 新文件坏了也还能继续用旧模型，
 *     不会出现「free 了还在用的指针」。调用方必须先销毁解释器再调这里。
 *   ★ LittleFS.begin() 是幂等的；这里用 begin(false) 不格式化，
 *     格式化语义交给 net_web.h 的 LittleFS.begin(true) 负责。
 * ------------------------------------------------------------------------- */
static bool modelLoad(bool reload = false)
{
    /* 已经加载过动态模型，且不是「刚换了文件」→ 直接复用，不重复读 flash。
       ★ 注意：reloadModel() 里必须传 true。传 false 即使 LittleFS 里的文件被换了
         也不会重读，推理结果当然不会变 —— 表现就是「下载成功了但识别没变化」。 */
    if (!reload && g_model_dyn) return true;

    const char *path = "/amg_model_int8.tflite";

    if (!LittleFS.begin(false)) {
        Serial.println(F("[模型] LittleFS 未挂载，使用内置模型"));
        return false;
    }
    if (!LittleFS.exists(path)) {
        Serial.println(F("[模型] 无 /amg_model_int8.tflite，使用内置模型"));
        return false;
    }

    File f = LittleFS.open(path, "r");
    if (!f) {
        Serial.println(F("[模型] 打开 .tflite 失败，使用内置模型"));
        return false;
    }

    size_t sz = f.size();
    if (sz < 1024) {                       /* 太小基本不是真模型 */
        Serial.printf("[模型] 文件仅 %u 字节，忽略\n", (unsigned)sz);
        f.close();
        return false;
    }

    unsigned char *buf = (unsigned char *)malloc(sz);
    if (!buf) {
        Serial.printf("[模型] 内存不足（需 %u 字节），使用内置模型\n", (unsigned)sz);
        f.close();
        return false;
    }

    size_t rd = f.readBytes((char *)buf, sz);
    f.close();
    if (rd != sz) {
        Serial.printf("[模型] 只读到 %u/%u 字节，使用内置模型\n",
                      (unsigned)rd, (unsigned)sz);
        free(buf);
        return false;
    }

    /* TFLite 文件头：偏移 4..7 应为 "TFL3" */
    if (!(buf[4] == 'T' && buf[5] == 'F' && buf[6] == 'L' && buf[7] == '3')) {
        Serial.println(F("[模型] 文件不是 TFLite 格式，使用内置模型"));
        free(buf);
        return false;
    }

    /* ★ 到这里新模型已经验证通过，才释放旧缓冲。
       顺序反过来（先 free 后读）的话，新文件一坏旧模型就没了。 */
    if (g_model_dyn) {
        free(g_model_dyn);
        g_model_dyn     = nullptr;
        g_model_dyn_len = 0;
        g_model         = g_model_builtin;
        g_model_len     = g_model_builtin_len;
    }

    g_model_dyn     = buf;
    g_model_dyn_len = (unsigned int)sz;
    g_model         = g_model_dyn;
    g_model_len     = g_model_dyn_len;

    Serial.printf("[模型] 从 LittleFS 加载：%u 字节（内置 %u 字节）\n",
                  (unsigned)sz, (unsigned)g_model_builtin_len);
    return true;
}
